


		list	P=PIC18F2320	
		#include	<P18F2320.inc>
		
		errorlevel  -302 
	
	CONFIG	OSC = HSPLL
	CONFIG	FSCM = OFF
	CONFIG	IESO = OFF
	CONFIG	PWRT = OFF
	CONFIG	BOR = OFF
	CONFIG	BORV = 20
	CONFIG	WDT = OFF
	CONFIG	WDTPS = 1
	CONFIG	MCLRE = ON
	CONFIG	PBAD = DIG
	;CONFIG	PBAD = ANA
	;CONFIG	CCP2MX = C1
	CONFIG	STVR = ON
	CONFIG	LVP = ON
	CONFIG	DEBUG = OFF
	CONFIG	CP0 = OFF
	CONFIG	CP1 = OFF
	CONFIG	CP2 = OFF
	CONFIG	CP3 = OFF
	CONFIG	CPB = OFF
	CONFIG	CPD = OFF
	CONFIG	WRT0 = OFF
	CONFIG	WRT1 = OFF
	CONFIG	WRT2 = OFF
	CONFIG	WRT3 = OFF
	CONFIG	WRTB = OFF
	CONFIG	WRTC = OFF
	CONFIG	WRTD = OFF
	CONFIG	EBTR0 = OFF
	CONFIG	EBTR1 = OFF
	CONFIG	EBTR2 = OFF
	CONFIG	EBTR3 = OFF
	CONFIG	EBTRB = OFF
	;	__CONFIG	_CONFIG1H,  _IESO_OFF_1H & _FSCM_OFF_1H & _HSPLL_OSC_1H
	;	__CONFIG	_CONFIG2L,  _BORV_45_2L & _BOR_OFF_2L & _PWRT_OFF_2L
	;	__CONFIG	_CONFIG2H,  _WDTPS_32K_2H & _WDT_OFF_2H
	;	__CONFIG	_CONFIG3H,  _MCLRE_ON_3H & _PBAD_DIG_3H & _CCP2MX_ON_3H  &  _CCP2MX_C1_3H			;PBはデジタル
	;	;__CONFIG	_CONFIG3H,  _MCLRE_ON_3H & _PBAD_ANA_3H & _CCP2MX_ON_3H  &  _CCP2MX_C1_3H			;RBはアナログ
	;	;_PBAD_DIG_3HでRBをデジタルかアナログかを区別している
	;	;_CCP2MX_ON_3H  &  _CCP2MX_C1_3H でRC1をCCPに割り当てている
	;	__CONFIG	_CONFIG4L,  _DEBUG_OFF_4L & _LVP_ON_4L & _STVR_ON_4L
	;	__CONFIG	_CONFIG5L,  _CP0_OFF_5L & _CP1_OFF_5L & _CP2_OFF_5L  &  _CP3_OFF_5L
	;	__CONFIG	_CONFIG5H,  _CPD_OFF_5H & _CPB_OFF_5H
	;	__CONFIG	_CONFIG6L,  _WRT0_OFF_6L & _WRT1_OFF_6L & _WRT2_OFF_6L  &  _WRT3_OFF_6L
	;	__CONFIG	_CONFIG6H,  _WRTD_OFF_6H & _WRTB_OFF_6H & _WRTC_OFF_6H
	;	__CONFIG	_CONFIG7L,  _EBTR0_OFF_7L & _EBTR1_OFF_7L & _EBTR2_OFF_7L  &  _EBTR3_OFF_7L
	;	__CONFIG	_CONFIG7H,  _EBTRB_OFF_7H
		
;******************************
	;変数定義
;******************************
	CBLOCK		000H
	BUFFER
	COUNT01	
	COUNT02
	DATA_1BYRE	
	WORK1	;割り込み時のメインプログラムのデータの
							;退避場所．
	ENDC
;************************************
		ORG		0
		BRA		INIT
		;高位割り込みベクタ
		ORG     0x008
		
		;低位割り込みベクタ
		ORG     0x018
		
		
		
;********初期化*********************
INIT
		MOVLW		B'00001111'		;すべてデジタルモード
		MOVWF		ADCON1			;
		CLRF		TRISA			;
		MOVLW		B'11111111'		;
		MOVWF		TRISC			
		
		
		
;*********メイン関数****************
MAINLOOP
		BTFSS	PORTC,RC3
		BRA		CASE_B
		
;*******RC3==1スイッチOFFのとき
CASE_A
		MOVLW	B'00111100'
		MOVWF	PORTA
		BRA		MAINLOOP
		
;*******RC3==0スイッチONのとき
CASE_B
		MOVLW	B'00000000'
		MOVWF	PORTA
		BRA		MAINLOOP
		
		
		END
